## conf/layer.conf
```bitbake
# We have a conf and classes directory, add to BBPATH
BBPATH := "${BBPATH}:${LAYERDIR}"

# We have an images and various recipe-* directories, add to BBFILES
BBFILES := "${BBFILES} ${LAYERDIR}/recipes*/*/*.bb*"

BBFILE_COLLECTIONS += "cgx-msd-xilinx"
BBFILE_PATTERN_cgx-msd-xilinx := "^${LAYERDIR}/"
BBFILE_PRIORITY_cgx-msd-xilinx = "7"

LAYERSERIES_COMPAT_cgx-msd-xilinx = "kirkstone"

LAYERDEPENDS_cgx-msd-xilinx = "core "
```

## conf/machine/ultra96-zynqmp.conf
```bitbake
#@TYPE: Machine
#@NAME: ultra96-zynqmp
#@DESCRIPTION: Machine support for Ultra96 Evaluation Board.
#

SOC_VARIANT ?= "eg"

require conf/machine/include/tune-zynqmp.inc
require conf/machine/include/machine-xilinx-overrides.inc
require conf/machine/include/machine-xilinx-default.inc
require conf/machine/include/machine-xilinx-board.inc
require conf/machine/include/machine-xilinx-qemu.inc
include conf/machine/include/zynqmp-pmu-config.inc

MACHINE_FEATURES = "rtc ext2 ext3 vfat usbhost usbgadget wifi bluetooth mipi"

UBOOT_MACHINE = "xilinx_zynqmp_zcu100_revC_defconfig"

SERIAL_CONSOLE = "115200 ttyPS0"

SERIAL_CONSOLES_CHECK = "${SERIAL_CONSOLES}"

KERNEL_DEVICETREE = "xilinx/zynqmp-zcu100-revC.dtb"

MACHINE_ESSENTIAL_EXTRA_RRECOMMENDS += "linux-firmware-wl18xx"

include ${@bb.utils.contains("LICENSE_FLAGS_WHITELIST", "xilinx", "", "conf/machine/include/xilinx-no-whitelist.inc", d)}
```
